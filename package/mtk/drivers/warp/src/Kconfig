## package/mtk/drivers/warp/src/Kconfig
```kconfig
config WARP_VERSION
        int "WARP Driver HW Version Support"
        range 1 3
        default 1 if TARGET_mediatek_mt7622
        default 2 if TARGET_mediatek_mt7627
        default 3 if TARGET_mediatek_mt7988

config WARP_DBG_SUPPORT
        bool "WARP Driver Debug Info Support"
        default y

config WED_HW_RRO_SUPPORT
        bool "WED HW RRO Support"
        default n
```
